## boards/modkeys/planck/Kconfig
```kconfig
# SPDX-License-Identifier: MIT

config BOARD_ENABLE_DCDC
    bool "Enable DCDC mode"
    default y

config BOARD_ENABLE_DCDC_HV
    bool "Enable High Voltage DCDC mode"
    default y
```

## boards/modkeys/planck/Kconfig.defconfig
```kconfig
# Copyright (c) 2020 The ZMK Contributors
# SPDX-License-Identifier: MIT

if BOARD_PLANCK_LEFT

config ZMK_KEYBOARD_NAME
    default "PlanckBoy Color"

config ZMK_SPLIT_ROLE_CENTRAL
    default y

endif # BOARD_PLANCK_LEFT

if BOARD_PLANCK_LEFT || BOARD_PLANCK_RIGHT

config ZMK_SPLIT
    default y

if USB

config USB_DEVICE_STACK
    default y

endif # USB

if LVGL

config ZMK_DISPLAY_DEDICATED_THREAD_STACK_SIZE
    default 8192

config LV_Z_VDB_SIZE
    default 64

config LV_DPI_DEF
    default 148

config LV_Z_BITS_PER_PIXEL
    default 1

choice LV_COLOR_DEPTH
    default LV_COLOR_DEPTH_1
endchoice

endif # LVGL

endif # BOARD_PLANCK_LEFT || BOARD_PLANCK_RIGHT
```
